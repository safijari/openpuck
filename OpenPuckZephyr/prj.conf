## CMakeLists.txt
```
# OpenPuck — Zephyr RTOS port.
#
# Migrated from the Arduino/Adafruit-nRF52/TinyUSB sketch in ../OpenPuck.
# Build (from a west workspace with this repo reachable):
#   west build -b adafruit_feather_nrf52840 OpenPuckZephyr
#
# The bare-metal RADIO peripheral is driven directly (no BLE/802.15.4), so the
# Bluetooth/IEEE802154/MPSL stacks are disabled in prj.conf and the RADIO IRQ is
# owned by this app.
cmake_minimum_required(VERSION 3.20.0)

find_package(Zephyr REQUIRED HINTS $ENV{ZEPHYR_BASE})
project(openpuck C CXX)

# Build provenance: generate git_version.h (build_info.h picks it up via
# __has_include; absent -> "unknown"). Mirrors gen_version.sh in the Arduino tree.
execute_process(
  COMMAND git -C ${CMAKE_CURRENT_SOURCE_DIR} rev-parse --short=8 HEAD
  OUTPUT_VARIABLE OPK_GIT_HASH OUTPUT_STRIP_TRAILING_WHITESPACE
  ERROR_QUIET)
if(NOT OPK_GIT_HASH)
  set(OPK_GIT_HASH "unknown")
endif()
file(WRITE ${CMAKE_CURRENT_BINARY_DIR}/gen/git_version.h
  "// AUTO-GENERATED by CMake -- do not edit.\n#pragma once\n#define OPK_GIT_HASH \"${OPK_GIT_HASH}\"\n#define OPK_GIT_DIRTY 0\n")

target_include_directories(app PRIVATE
  ${CMAKE_CURRENT_SOURCE_DIR}/src
  ${CMAKE_CURRENT_SOURCE_DIR}/src/compat
  ${CMAKE_CURRENT_BINARY_DIR}/gen)

# status_led uses Arduino logical pin numbers; under the absolute-nRF-pin
# digitalWrite shim, the SuperMini's P0.15 blue LED is absolute pin 15 (the
# header's default 24 is the Adafruit logical pin). LED_BUILTIN (P1.15 = 47) is
# set in the Arduino.h shim.
target_compile_definitions(app PRIVATE WAKE_LED_PIN_B=15)

target_sources(app PRIVATE
  src/main.cpp

  # compatibility layer
  src/compat/arduino_compat.cpp
  src/compat/littlefs_shim.cpp
  src/compat/serial_cdc_glue.cpp
  src/compat/usb_glue.cpp           # Zephyr USBD backing for the TinyUSB shim
  src/compat/usb_device_setup.cpp   # usbd_context (HID pool + CDC) bring-up
  src/compat/usb_webusb_class.cpp   # WebUSB vendor class (config panel pipe)
  src/compat/usb_xinput_class.cpp   # XInput (Xbox) vendor class

  # ported firmware modules
  src/config.cpp
  src/bonds.cpp
  src/identity.cpp
  src/triton.cpp
  src/gamepad_util.cpp
  src/radio.cpp
  src/rf_link.cpp
  src/rf_diag.cpp
  src/haptics.cpp
  src/status_led.cpp
  src/controllers.cpp
  src/puck_hid.cpp
  src/mode_lizard.cpp
  src/mode_switch_hori.cpp
  src/mode_switch_pro.cpp
  src/mode_ps5.cpp
  src/mode_hidgyro.cpp
  src/mode_xinput.cpp
  src/webusb_config.cpp
  src/serial_console.cpp
  src/usb_mount.cpp
  src/wake_hid.cpp
)
```

## prj.conf
```kconfig
# OpenPuck Zephyr configuration.
#
# The RADIO peripheral is driven bare-metal (reverse-engineered SC2 protocol),
# so NO Zephyr radio stack may claim it.
CONFIG_BT=n
CONFIG_IEEE802154=n
CONFIG_NRF_802154_RADIO_DRIVER=n

# C++ (the ported modes/protocol are C++).
CONFIG_CPP=y
CONFIG_STD_CPP17=y
CONFIG_REQUIRES_FULL_LIBCPP=n
CONFIG_CPP_EXCEPTIONS=n
CONFIG_CPP_RTTI=n

# Console/logging.
CONFIG_LOG=y
CONFIG_PRINTK=y

# USB device stack (next/USBD). The HID pool (app.overlay) + the board CDC ACM
# console register as classes; the firmware brings the stack up via the TinyUSB
# shim (USBDevice.attach -> opk_usbd_enable), not at boot.
CONFIG_USB_DEVICE_STACK_NEXT=y
CONFIG_USBD_HID_SUPPORT=y
CONFIG_USBD_CDC_ACM_CLASS=y
CONFIG_CDC_ACM_SERIAL_INITIALIZE_AT_BOOT=n
CONFIG_HWINFO=y
CONFIG_USBD_LOG_LEVEL_ERR=y
CONFIG_USBD_HID_LOG_LEVEL_ERR=y

# Core subsystems used by the port.
CONFIG_GPIO=y
CONFIG_FLASH=y
CONFIG_FLASH_MAP=y
CONFIG_REBOOT=y

# CRITICAL: link the image at the code partition (0x26000) so it loads where the
# Adafruit/nice!nano UF2 bootloader expects the application. Without this Zephyr
# links at 0x0 and the UF2 would overwrite the MBR/bootloader region (brick).
CONFIG_USE_DT_CODE_PARTITION=y

# Persistence: the Arduino tree stored cfg.bin/bonds.bin in the nRF52 internal
# LittleFS. We keep LittleFS (Zephyr's fs subsystem on the storage partition) so
# the persistence code ports behind a thin Adafruit_LittleFS shim.
CONFIG_FILE_SYSTEM=y
CONFIG_FILE_SYSTEM_LITTLEFS=y
CONFIG_FILE_SYSTEM_MKFS=y

# The firmware drives the WDT peripheral directly (NRF_WDT, ported verbatim from
# the Arduino setup()/loop()), so Zephyr's watchdog driver is left out to avoid
# double-ownership of the peripheral.

# Microsecond timing for the RF poll busy-waits comes from a dedicated 1 MHz
# nrfx TIMER in the compat layer (the kernel RTC tick is too coarse), so the
# kernel clock is left at its board default here.

# Reasonable main stack for the cooperative loop + protocol state.
CONFIG_MAIN_STACK_SIZE=4096
CONFIG_HEAP_MEM_POOL_SIZE=2048
```

## src/main.cpp
```c
// OpenPuck.ino -- Steam Controller 2 ("Triton") puck reimplementation for an nRF52840.
//
// This firmware impersonates the Valve puck over USB, maintains puck-style bond slots, speaks the
// reverse-engineered RF protocol to the controller, and re-enumerates into Steam, Xbox, Switch, PS5, or DS4
// personalities. Build with -DCFG_TUD_HID=4 (the Adafruit nRF port defaults to 2).
//
// This file is just the entry point: setup() builds the USB presentation for the persisted mode and arms the
// hardware watchdog; loop() pumps each subsystem. Everything substantive lives in the modules below -- see
// ARCHITECTURE.md for the full map. The short version:
//   config / identity / bonds  -- persisted settings, device serial, the four controller bond slots
//   radio / rf_link / rf_diag   -- bare-metal nRF52 RADIO, the operational puck protocol, and RE tooling
//   triton / gamepad_util       -- the decoded controller input (g_in) + shared host-report build helpers
//   controllers + mode_*        -- one IController per USB personality (puck/lizard, xbox, switch, ps5, ds4)
//   haptics / webusb_config / serial_console -- haptic relay, the browser config channel, the CDC debug CLI
//
// Protocol reference: docs/PROTOCOL.md.  Bond record = [8 uuid][16 serial].
#include <zephyr/kernel.h>
#include <Adafruit_TinyUSB.h>
#include <Adafruit_LittleFS.h>
#include <InternalFileSystem.h>
using namespace Adafruit_LittleFS_Namespace;

#include "config.h"

// OPK_GIT_HASH: tags the one-time factory-reset build
#include "build_info.h"
#include "identity.h"
#include "bonds.h"
#include "radio.h"
#include "controllers.h"
#include "haptics.h"
#include "rf_link.h"
#include "rf_diag.h"
#include "webusb_config.h"
#include "serial_console.h"
#include "wake_hid.h"
#include "status_led.h"
#include "usb_mount.h"
#include "identity.h"
#include <stdio.h>

#if CFG_TUD_HID < 4
#error "build with -DCFG_TUD_HID=4 (extra_flags): up to 4 HID interfaces per mode"
#endif

// puck composite (4 HID + WebUSB) exceeds the default 256 B config buffer
static uint8_t g_usbCfgDesc[512];

// Per-mode USB serial suffix (modes 1..8: X=xbox N=hori L=lizard P=swpro S=ps5 G=hidgyro Q=ps5game D=ds4game).
static const char MODE_SUFFIX[] = { 'X', 'N', 'L', 'P', 'S', 'G', 'Q', 'D' };
// Fixed-interface flags captured at boot so usbReenumerate (dynamic mount, no reboot) replays them.
static bool s_dynWantWebusb = false, s_dynWantWakeMouse = false;

// Dynamic re-enumeration (NO MCU reboot): tear down + rebuild the config descriptor presenting `k` connected-
// controller slots, replaying the fixed interfaces in locked HID-instance order (wake mouse = instance 0,
// before the slot pool; WebUSB is vendor-class so order-free), then re-attach. RF/firmware state survives.
// g_usbToBond must already be built for k connected controllers. Called at boot and by usb_mount's watcher.
void usbReenumerate(uint8_t k)
{
	USBDevice.detach();
	delay(20);
	USBDevice.clearConfiguration();
	USBDevice.setConfigurationBuffer(g_usbCfgDesc, sizeof g_usbCfgDesc);
	g_active->usbIdentity(); // clearConfiguration reset VID/PID/strings -- restore them
	// serial carries the mounted count so the host invalidates its cached config descriptor on a change
	snprintf(
		g_usbSerial, sizeof g_usbSerial, "%s%c%u", g_unit,
		MODE_SUFFIX[(g_usbMode >= 1 && g_usbMode <= 8) ? g_usbMode - 1 :
								 0],
		(unsigned)k);
	USBDevice.setSerialDescriptor(g_usbSerial);
	if (s_dynWantWakeMouse)
		wakeHidAddInterface(); // HID instance 0
	g_active->mountSlots(
		k); // mode's fixed HIDs (if any) + k slot interfaces
	if (s_dynWantWebusb)
		USBDevice.addInterface(usb_web);
	USBDevice.setConfigurationAttribute(0x80 | 0x20);
	USBDevice.attach();
}

void setup()
{
	// The bare-metal RADIO needs the high-frequency crystal (HFXO) for accurate
	// RF; the Adafruit core started it implicitly. Start it explicitly here.
	// (USB also forces HFXO on, but the radio may run before/without USB.)
	NRF_CLOCK->EVENTS_HFCLKSTARTED = 0;
	NRF_CLOCK->TASKS_HFCLKSTART = 1;
	for (uint32_t w = micros(); !NRF_CLOCK->EVENTS_HFCLKSTARTED &&
				    (uint32_t)(micros() - w) < 2000;)
		;

	genSerial();
	ledInit();

	// seed defaults so unbonded slots don't share the discovery address
	for (int s = 0; s < NSLOT; s++)
		rfGenSessionAddr(s);
	InternalFS.begin();
#if OPK_FACTORY_RESET
	// Recovery build (-DOPK_FACTORY_RESET=1): wipe ALL persistent storage ONCE on the first boot after flashing,
	// then persist normally (tracked by a git-hash tag so it does NOT wipe every boot). See config.h / config.cpp.
	factoryResetOnce(OPK_GIT_HASH);
#endif
	loadCfg();
	loadBonds();
	// regenerate per-slot session addresses from each bond UUID (deterministic, stable across reboots)
	for (int s = 0; s < NSLOT; s++)
		if (g_slot[s].used)
			rfGenSessionAddr(s);

	// decide USB presentation BEFORE registering interfaces
	g_xbox = !modeIsPuck(g_usbMode);
	g_active = controllerFor(g_usbMode);

	// ---- USB descriptor rebuild ----
	// Puck mode drops the CDC serial console (clearConfiguration) to free a USB endpoint for the wake-mouse
	// interface that wakes a sleeping Windows host. The one-shot debug arm (g_debugCdcThisBoot, set via WebUSB
	// panel / CDC 'D', auto-reverting after one boot) instead KEEPS the boot CDC composite and skips the wake
	// mouse (no endpoint room for both). Clean modes always rebuild bare.
	const bool puckMode = g_active->isPuck();
	const bool keepCdc = puckMode && g_debugCdcThisBoot;
	// The "game" PlayStation modes enumerate as a CLEAN single HID gamepad so games that classify off the raw HID
	// device (Fortnite/UE GameInput, Windows.Gaming.Input) recognise them as PlayStation. A real Sony pad is just
	// the gamepad HID (+ a USB-audio interface); our extra wake-mouse HID and WebUSB vendor interface make those
	// classifiers refuse the PS glyph path even with the correct VID/PID (SDL/Steam tolerate the extras). So
	// clean-PS modes skip BOTH the wake mouse and WebUSB -- no config panel / host-wake; chord back to Steam
	// (back-paddle 4 + A) to reach the panel. Normal MODE_PS5 / MODE_HIDGYRO keep wake + panel.
	const bool psClean = modeIsCleanPS(g_usbMode);
	const bool dynamic = g_active->dynamicMount();

	if (dynamic) {
		// Dynamic mount: present only ACTIVELY-CONNECTED controllers; usbReenumerate re-attaches (no reboot)
		// as the set changes. Emulated modes are never puck; clean-PS drops the wake mouse + WebUSB.
		s_dynWantWakeMouse = !psClean;
		s_dynWantWebusb = !psClean;
		USBDevice.detach();
		delay(30);
		USBDevice.clearConfiguration();
		USBDevice.setConfigurationBuffer(g_usbCfgDesc,
						 sizeof g_usbCfgDesc);
		// Lock TinyUSB HID instance indices ONCE, canonical order: wake mouse (HID 0) then the mode's pool.
		if (s_dynWantWakeMouse)
			wakeHidBegin();
		g_active->beginPool();
		if (s_dynWantWebusb)
			usb_web.begin();
		usbMountEnable(true, g_active->maxSlots());
		usbMountRebuildMap(); // initial connected set (usually empty at cold boot)
		usbReenumerate(
			g_usbMountCount); // build the live descriptor + attach
	} else {
		USBDevice.detach();
		delay(30);
		if (keepCdc) {
			USBDevice.setConfigurationBuffer(g_usbCfgDesc,
							 sizeof g_usbCfgDesc);
		} else {
			USBDevice.clearConfiguration();

			// headroom over the default 256 B cap
			USBDevice.setConfigurationBuffer(g_usbCfgDesc,
							 sizeof g_usbCfgDesc);
		}

		// Distinct USB serial PER MODE (must be set AFTER clearConfiguration, which nulls it). Hosts cache USB
		// identity by VID:PID:serial; reusing one serial under a changing VID:PID can make a host refuse the new
		// identity. Steam keeps the exact unit serial (its pairing identity); the others get a 1-char suffix.
		if (puckMode) {
			USBDevice.setSerialDescriptor(g_unit);
		} else {
			// Bond count in serial so Windows invalidates its cached config descriptor if the count changes.
			snprintf(g_usbSerial, sizeof g_usbSerial, "%s%c%d",
				 g_unit, MODE_SUFFIX[g_usbMode - 1],
				 bondedSlotCount() > 0 ? bondedSlotCount() : 1);
			USBDevice.setSerialDescriptor(g_usbSerial);
		}

		// SDL3's Proteus/Triton HIDAPI driver only binds slot HIDs on USB interfaces 2..5. Register WebUSB (IF 0)
		// and the wake mouse (IF 1) before the four puck slots so hid[0..3] land on IF 2..5 like the real puck.
		if (puckMode)
			usb_web.begin();
		if (puckMode && !keepCdc)
			wakeHidBegin();

		g_active->begin();

		// Boot-mouse wake interface for clean (non-puck) modes, and for puck on the one-shot debug boot (CDC on,
		// no endpoint room for wake mouse on a normal puck boot -- wake is registered above instead). Skipped for PS
		// modes so the device stays a single clean HID gamepad (see psClean above).
		if (!puckMode && !keepCdc && !psClean)
			wakeHidBegin();

		// WebUSB config panel -- every mode EXCEPT the PlayStation modes. Puck: registered above (IF 0) before wake +
		// slots; other clean modes after controller. PS modes omit it to present a genuine single-HID PS controller.
		if (!puckMode && !psClean)
			usb_web.begin();
		// bmAttributes: required(0x80) | remote_wakeup(0x20). Remote Wakeup lets us signal wake-from-sleep.
		USBDevice.setConfigurationAttribute(0x80 | 0x20);

		// re-attach with the final descriptor (host re-reads it fresh -> deterministic enumeration)
		USBDevice.attach();
	}
	Serial.begin(115200);
	for (int i = 0; i < 300 && !USBDevice.mounted(); i++)
		delay(10); // wait up to 3s for USB mount, but NEVER hang
	if (USBDevice.suspended()) {
		USBDevice.remoteWakeup();
		ledWakePulse();
	} // wake host if bus was sleeping when we (re-)attached
	hapticInit();
	static const char *MODE_NAME[] = {
		"STEAM(puck)",	       "XBOX(xinput+mouse)",
		"SWITCH(horipad)",     "LIZARD(puck kb/mouse)",
		"SWITCH(pro+gyro)",    "PS5(dualsense)",
		"HIDGYRO(ds4+motion)", "PS5(dualsense,game/clean)",
		"DS4(ds4,game/clean)"
	};
	Serial.printf("# copycat up: unit=%s board=%s, mode=%s\n", g_unit,
		      g_board,
		      MODE_NAME[g_usbMode <= MODE_MAX ? g_usbMode : 0]);
	if (puckMode)
		Serial.printf(
			"# puck USB: %s\n",
			keepCdc ?
				"DEBUG boot (CDC console on, wake mouse off; reverts next boot)" :
				"normal (CDC off, wake mouse on)");
	Serial.printf(
		"# session ch%u (discovery on ibex/ch2); per-slot session addrs:\n",
		g_sessCh);
	for (int s = 0; s < NSLOT; s++) {
		if (g_slot[s].used) {
			Serial.printf(
				"#   slot %d: %02X%02X%02X%02X/%02X (uuid %02X%02X%02X%02X %02X%02X%02X%02X)\n",
				s, g_sessBase[s][0], g_sessBase[s][1],
				g_sessBase[s][2], g_sessBase[s][3],
				g_sessPrefix[s], g_slot[s].rec[0],
				g_slot[s].rec[1], g_slot[s].rec[2],
				g_slot[s].rec[3], g_slot[s].rec[4],
				g_slot[s].rec[5], g_slot[s].rec[6],
				g_slot[s].rec[7]);
		}
	}
	// Hardware watchdog: if loop() ever stops feeding it (wedged radio busy-wait, HardFault spin, blocked CDC
	// write) the WDT resets the nRF52 after ~8s, re-enumerating USB + re-initialising RF, so a hang no longer
	// needs a physical replug. RUN keeps it counting in sleep; PAUSE freezes it under a debugger.
	NRF_WDT->CONFIG = (WDT_CONFIG_HALT_Pause << WDT_CONFIG_HALT_Pos) |
			  (WDT_CONFIG_SLEEP_Run << WDT_CONFIG_SLEEP_Pos);
	NRF_WDT->CRV = 8UL * 32768UL - 1; // timeout in 32.768 kHz ticks (~8 s)
	NRF_WDT->RREN = WDT_RREN_RR0_Msk; // arm reload register 0
	NRF_WDT->TASKS_START = 1;
}

// loop-timing diagnostics: poll rate is capped by loop ITERATION time (pacing wants 4000us but the poll only
// fires as often as the loop comes around). Per-section us accumulates and each second the avg loop period +
// slowest section are published for the WebUSB panel.

// avg loop iteration time last second (1e6/iterations)
uint16_t g_loopPeriodUs = 0;

// index of the slowest section: 0=webusb 1=ctrl.task 2=serial 3=rfdiag 4=rflink 5=haptic 6=led
uint8_t g_loopWorst = 0;
uint16_t g_loopWorstUs = 0; // that section's avg us per iteration
void loop()
{
	// feed the watchdog; if we ever stop, the ~8s WDT auto-resets us
	NRF_WDT->RR[0] = WDT_RR_RR_Reload;
	if (g_dirty) {
		g_dirty = false;
		saveBonds();
	}
#if OPK_LOG
	// Diagnostic build: time each loop section so the panel can show the slowest one + the loop period.
	static uint32_t acc[7] = { 0 };
	static uint32_t loops = 0;
	static unsigned long secMs = 0;
	uint32_t t;
	t = micros();
	webusbPoll();
	acc[0] += (uint32_t)(micros() - t);
	t = micros();
	if (g_active)
		g_active->task();
	acc[1] += (uint32_t)(micros() - t);
	t = micros();
	serialConsolePoll();
	acc[2] += (uint32_t)(micros() - t);
	t = micros();
	rfDiagTask();
	acc[3] += (uint32_t)(micros() - t);
	t = micros();
	rfLinkTask();
	acc[4] += (uint32_t)(micros() - t);
	t = micros();
	hapticTask();
	acc[5] += (uint32_t)(micros() - t);
	t = micros();
	ledTask();
	acc[6] += (uint32_t)(micros() - t);
	usbMountTask(); // dynamic mount/unmount of connected controllers (no-op unless enabled)
	loops++;
	if (millis() - secMs >= 1000) {
		g_loopPeriodUs = loops ? (uint16_t)(1000000UL / loops) : 0;
		uint8_t wi = 0;
		uint32_t wv = 0;
		for (int i = 0; i < 7; i++) {
			if (acc[i] > wv) {
				wv = acc[i];
				wi = i;
			}
			acc[i] = 0;
		}
		g_loopWorst = wi;
		g_loopWorstUs = loops ? (uint16_t)(wv / loops) : 0;
		loops = 0;
		secMs = millis();
	}
#else
	webusbPoll();
	if (g_active)
		g_active->task();
	serialConsolePoll();
	rfDiagTask();
	rfLinkTask();
	hapticTask();
	ledTask();
	usbMountTask(); // dynamic mount/unmount of connected controllers (no-op unless enabled)
#endif
}

// Zephyr entry. The Arduino runtime called setup() once then loop() forever; we
// do the same on the main thread. The loop is intentionally tight (the RF poll
// cadence depends on coming around quickly), but we k_yield() each iteration so
// the cooperative USBD stack thread always gets CPU for control transfers.
// Bring-up diagnostic via the nice!nano blue LED (P0.15 = absolute pin 15):
//   3 slow blinks  -> main() reached (bootloader handoff + C++ init OK)
//   6 fast blinks  -> setup() returned (USB/radio/persistence init didn't hang)
//   then ~1 Hz heartbeat in the loop -> the cooperative loop is running
// Tells us where it dies when USB never enumerates. Remove once USB is up.
#define OPK_DIAG_LED 15
static void diag_blink(int n, int ms)
{
	for (int i = 0; i < n; i++) {
		digitalWrite(OPK_DIAG_LED, HIGH);
		delay(ms);
		digitalWrite(OPK_DIAG_LED, LOW);
		delay(ms);
	}
}

int main(void)
{
	pinMode(OPK_DIAG_LED, OUTPUT);
	diag_blink(3, 200); // main() reached
	setup();
	diag_blink(6, 70); // setup() returned
	uint32_t last = millis();
	for (;;) {
		loop();
		k_yield();
		if (millis() - last >= 500) {
			last = millis();
			digitalWrite(OPK_DIAG_LED,
				     (millis() / 500) & 1 ? HIGH : LOW);
		}
	}
	return 0;
}
```

## src/mode_xinput.cpp
```c
// mode_xinput.cpp -- Xbox 360 wired (XInput) personality (MODE_XBOX): one XInput gamepad per bonded controller.
//
// Real Xbox 360 pads are NOT HID: they use a vendor interface (class 0xFF / sub 0x5D / proto 0x01) carrying a
// 20-byte XInput report. A custom TinyUSB class driver serves that interface plus a second boot-mouse interface
// for the right trackpad. Host binds by VID/PID (045E:028E) + the FF/5D/01 interface. The OUT endpoint carries
// rumble, relayed to the controller as a haptic by task().
//
// Multi-controller: one XInput interface per CONNECTED controller (dynamic mount -- see usb_mount.h; the device
// re-enumerates without rebooting as controllers connect/disconnect). The single class driver routes xfer/open
// callbacks by endpoint address into the per-bond-slot state; xi_open claims slots in connection order. The
// right-pad mouse is a single shared interface (only bond slot 0's right-pad drives it).
#include "mode_xinput.h"
#include "triton.h"
#include "gamepad_util.h"
#include "config.h"
#include "haptics.h"
#include "bonds.h"
#include "usb_mount.h"
#include <Adafruit_TinyUSB.h>
#include <Arduino.h>
#include <string.h>

// Zephyr XInput custom class bridge (usb_xinput_class.cpp).
extern "C" bool opk_xinput_ready(void);
extern "C" bool opk_xinput_send(const uint8_t *rep, uint16_t n);
extern "C" void opk_xinput_begin(void);
// rumble decode hook the class calls on an OUT packet (-> Steam rumble relay).
extern "C" void opk_xinput_rumble(uint8_t big, uint8_t sml)
{
	hapticSteamRumble((uint16_t)big * 257u, (uint16_t)sml * 257u, 0);
}

// custom class-driver API for the XInput interface
extern "C" {
#include "device/usbd_pvt.h"
}

XboxController g_xboxCtl;

// XInput button bits
enum {
	XB_DUP = 0x0001,
	XB_DDOWN = 0x0002,
	XB_DLEFT = 0x0004,
	XB_DRIGHT = 0x0008,
	XB_START = 0x0010,
	XB_BACK = 0x0020,
	XB_L3 = 0x0040,
	XB_R3 = 0x0080,
	XB_LB = 0x0100,
	XB_RB = 0x0200,
	XB_GUIDE = 0x0400,
	XB_A = 0x1000,
	XB_B = 0x2000,
	XB_X = 0x4000,
	XB_Y = 0x8000
};

// ===================== XInput custom TinyUSB class driver =====================
// Custom class driver + an Adafruit_USBD_Interface subclass emitting the interface + 0x21-blob + 2 endpoints.
// Per-slot state lives in g_xiSlot[]: each XInput interface gets one. The class driver dispatches open/xfer
// by endpoint address; xinputSend() targets a specific slot's IN endpoint.
#define XINPUT_DESC_LEN \
	(9 + 17 + 7 + 7) // interface(9)+vendor0x21(17)+IN ep(7)+OUT ep(7) = 40

// per-slot state. `inUse` is set in xi_open from the USB ISR and read in xinputSend from the loop -- mark
// volatile so the loop doesn't observe a stale 0 across a freshly-attached interface.
struct XiSlot {
	uint8_t itf, epIn, epOut;
	uint8_t inBuf[32], outBuf[32];
	volatile uint16_t rumbleLow,
		rumbleHigh; // last host rumble values, x 257
	volatile unsigned long
		rumbleMs; // millis of last OUT packet (stuck-rumble watchdog)
	volatile bool inUse;
};
static XiSlot g_xiSlot[NSLOT];
// Dynamic mount: xi_open is called once per XInput interface in descriptor order; this counts them so the
// u-th interface claims the u-th connected controller (g_usbToBond[u]). Reset on every (re)enumeration.
static uint8_t g_xiOpenU = 0;
// release a held rumble if no OUT packet refreshes it for this long (covers a lost stop)
#define RUMBLE_STUCK_MS 2500u

static void xi_init(void)
{
	for (int s = 0; s < NSLOT; s++)
		g_xiSlot[s].inUse = false;
}
static bool xi_deinit(void)
{
	return true;
}
static void xi_reset(uint8_t rhport)
{
	(void)rhport;
	g_xiOpenU =
		0; // restart per-interface claim ordering for this enumeration
	for (int s = 0; s < NSLOT; s++) {
		g_xiSlot[s].itf = 0;
		g_xiSlot[s].epIn = g_xiSlot[s].epOut = 0;
		g_xiSlot[s].inUse = false;
	}
}
// TinyUSB calls xi_open once per XInput interface in the config descriptor. Claim the first free BONDED
// slot so the xiSlot index matches the bond-slot index (begin() registers them in ascending bond-slot order).
// Fallback to any free slot when there are no bonds (fresh device).
static uint16_t xi_open(uint8_t rhport, tusb_desc_interface_t const *itf,
			uint16_t max_len)
{
	if (!(itf->bInterfaceClass == 0xFF && itf->bInterfaceSubClass == 0x5D &&
	      itf->bInterfaceProtocol == 0x01))
		return 0;
	// The u-th XInput interface in the descriptor serves the u-th connected controller. g_xiSlot is keyed by
	// BOND slot so onReport45(bond)/rumble route straight through; only connected bonds get an interface.
	uint8_t u = g_xiOpenU++;
	int slot = (u < g_usbMountCount) ? g_usbToBond[u] : -1;
	if (slot < 0) { // fallback (e.g. map not built): first free slot
		for (int s = 0; s < NSLOT; s++)
			if (!g_xiSlot[s].inUse) {
				slot = s;
				break;
			}
	}
	if (slot < 0 || slot >= NSLOT || g_xiSlot[slot].inUse)
		return 0;
	XiSlot &S = g_xiSlot[slot];
	S.itf = itf->bInterfaceNumber;
	uint8_t const *p = (uint8_t const *)itf;
	uint8_t const *end = p + max_len;
	uint16_t used = itf->bLength;
	p += itf->bLength;
	uint8_t opened = 0;
	while (p < end && opened < itf->bNumEndpoints) {
		uint8_t blen = p[0], btype = p[1];
		if (btype == TUSB_DESC_ENDPOINT) {
			tusb_desc_endpoint_t const *ep =
				(tusb_desc_endpoint_t const *)p;
			usbd_edpt_open(rhport, ep);
			if (tu_edpt_dir(ep->bEndpointAddress) == TUSB_DIR_IN)
				S.epIn = ep->bEndpointAddress;
			else
				S.epOut = ep->bEndpointAddress;
			opened++;
		}
		used += blen;
		p += blen;
	}
	S.inUse = true;
	// arm OUT (rumble/LED)
	if (S.epOut)
		usbd_edpt_xfer(rhport, S.epOut, S.outBuf, sizeof S.outBuf);
	return used;
}
static bool xi_ctrl(uint8_t rhport, uint8_t stage,
		    tusb_control_request_t const *req)
{
	(void)rhport;
	(void)req;
	return stage != CONTROL_STAGE_SETUP;
}
// Route an endpoint xfer callback to the slot that owns that endpoint.
static bool xi_xfer(uint8_t rhport, uint8_t ep, xfer_result_t res, uint32_t n)
{
	(void)res;
	for (int s = 0; s < NSLOT; s++) {
		XiSlot &S = g_xiSlot[s];
		if (!S.inUse)
			continue;
		if (ep == S.epOut) {
			// XInput rumble packet: [00][08][00][bigMotor][smallMotor][00][00][00]; LED pkt is [01][03][led]
			if (n >= 5 && S.outBuf[0] == 0x00 &&
			    S.outBuf[1] == 0x08) {
				uint8_t big = S.outBuf[3], sml = S.outBuf[4];
				uint16_t lo = (uint16_t)big * 257u;
				uint16_t hi = (uint16_t)sml * 257u;
				S.rumbleLow = lo;
				S.rumbleHigh = hi;
				S.rumbleMs = millis();
				hapticSteamRumble(lo, hi, (uint8_t)s);
			}
			usbd_edpt_xfer(rhport, S.epOut, S.outBuf,
				       sizeof S.outBuf);
			return true;
		}
	}
	return true;
}
static const usbd_class_driver_t g_xiDriver = {
#if CFG_TUSB_DEBUG >= 2
	.name = "XINPUT",
#endif
	.init = xi_init,
	.deinit = xi_deinit,
	.reset = xi_reset,
	.open = xi_open,
	.control_xfer_cb = xi_ctrl,
	.xfer_cb = xi_xfer,
	.sof = NULL
};
extern "C" const usbd_class_driver_t *usbd_app_driver_get_cb(uint8_t *count)
{
	*count = 1;
	return &g_xiDriver;
}

class Adafruit_USBD_XInput : public Adafruit_USBD_Interface {
    public:
	uint16_t getInterfaceDescriptor(uint8_t, uint8_t *buf,
					uint16_t bufsize) override
	{
		if (!buf)
			return XINPUT_DESC_LEN;
		if (bufsize < XINPUT_DESC_LEN)
			return 0;
		uint8_t itfnum = TinyUSBDevice.allocInterface(1);
		uint8_t epin = TinyUSBDevice.allocEndpoint(TUSB_DIR_IN),
			epout = TinyUSBDevice.allocEndpoint(TUSB_DIR_OUT);
		const uint8_t t[XINPUT_DESC_LEN] = {
			9, TUSB_DESC_INTERFACE, itfnum, 0x00, 0x02, 0xFF, 0x5D,
			0x01, _strid, 0x11, 0x21, 0x00, 0x01, 0x01, 0x25, epin,
			0x14, 0x00, 0x00, 0x00, 0x00, 0x13, epout, 0x08, 0x00,
			0x00, 7, TUSB_DESC_ENDPOINT, epin, TUSB_XFER_INTERRUPT,
			U16_TO_U8S_LE(0x20),

			// bInterval 1ms (1000Hz) so the RF rate is the only limit
			1, 7, TUSB_DESC_ENDPOINT, epout, TUSB_XFER_INTERRUPT,
			U16_TO_U8S_LE(0x20), 8
		};
		memcpy(buf, t, XINPUT_DESC_LEN);
		return XINPUT_DESC_LEN;
	}
	bool begin()
	{
		return TinyUSBDevice.addInterface(*this);
	}
};
// NSLOT instances: each registers its own XInput interface (own itfnum + IN/OUT ep pair) during begin().
// begin() in XboxController::begin() runs in order 0..NSLOT-1, so xi_open's first-free assignment lines up.
static Adafruit_USBD_XInput g_xinput[NSLOT];
static void xinputSend(uint8_t slot, uint16_t buttons, uint8_t lt, uint8_t rt,
		       int16_t lx, int16_t ly, int16_t rx, int16_t ry)
{
	// Zephyr port: a single XInput interface (controller 0) via the Zephyr
	// custom class (usb_xinput_class.cpp). The TinyUSB per-slot endpoint
	// bookkeeping (g_xiSlot) is unused here.
	if (slot != 0 || !opk_xinput_ready())
		return;
	uint8_t r[20];
	r[0] = 0x00;
	r[1] = 0x14;
	r[2] = buttons & 0xFF;
	r[3] = buttons >> 8;
	r[4] = lt;
	r[5] = rt;
	r[6] = lx & 0xFF;
	r[7] = lx >> 8;
	r[8] = ly & 0xFF;
	r[9] = ly >> 8;
	r[10] = rx & 0xFF;
	r[11] = rx >> 8;
	r[12] = ry & 0xFF;
	r[13] = ry >> 8;
	memset(r + 14, 0, 6);
	opk_xinput_send(r, 20);
}

// ===================== right-pad mouse interface =====================
static const uint8_t MOUSE_HID_DESC[] = { TUD_HID_REPORT_DESC_MOUSE() };
static Adafruit_USBD_HID
	g_mouse; // Xbox-mode mouse interface (right trackpad, slot 0 only)

// ===================== report 0x45 -> XInput + mouse =====================
// button code (g_back[], g_abSwap targets) -> legacy XInput bit. 0=none 1=A 2=B 3=X 4=Y 5=LB 6=RB 7=L3 8=R3 9=Back 10=Start 11=Guide 12=Dup 13=Ddown 14=Dleft 15=Dright
static uint16_t codeToXB(uint8_t c)
{
	switch (c) {
	case 1:
		return XB_A;
	case 2:
		return XB_B;
	case 3:
		return XB_X;
	case 4:
		return XB_Y;
	case 5:
		return XB_LB;
	case 6:
		return XB_RB;
	case 7:
		return XB_L3;
	case 8:
		return XB_R3;
	case 9:
		return XB_BACK;
	case 10:
		return XB_START;
	case 11:
		return XB_GUIDE;
	case 12:
		return XB_DUP;
	case 13:
		return XB_DDOWN;
	case 14:
		return XB_DLEFT;
	case 15:
		return XB_DRIGHT;
	default:
		return 0;
	}
}
static void rfXboxGamepad(uint8_t slot, const uint8_t *r)
{
	uint32_t b = btnsOf(r);
	if (g_qamMap && (b & TB_QAM)) {
		b &= ~(uint32_t)TB_QAM;
		b |= tritonFromCode(g_qamMap);
	}
	uint16_t btn = 0;
	if (b & TB_DUP)
		btn |= XB_DUP;
	if (b & TB_DDN)
		btn |= XB_DDOWN;
	if (b & TB_DLF)
		btn |= XB_DLEFT;
	if (b & TB_DRT)
		btn |= XB_DRIGHT;
	if (b & TB_VIEW)
		btn |= XB_START;
	if (b & TB_MENU)
		btn |= XB_BACK;
	if (b & TB_STEAM)
		btn |= XB_GUIDE;
	if (b & TB_LB)
		btn |= XB_LB;
	if (b & TB_RB)
		btn |= XB_RB;
	if (b & TB_L3)
		btn |= XB_L3;
	if (b & TB_R3)
		btn |= XB_R3;
	// face buttons, with optional A/B + X/Y swap (Nintendo layout)
	uint16_t fA = g_abSwap ? XB_B : XB_A, fB = g_abSwap ? XB_A : XB_B,
		 fX = g_abSwap ? XB_Y : XB_X, fY = g_abSwap ? XB_X : XB_Y;
	if (b & TB_A)
		btn |= fA;
	if (b & TB_B)
		btn |= fB;
	if (b & TB_X)
		btn |= fX;
	if (b & TB_Y)
		btn |= fY;
	// back paddles -> configurable mapping (default L4->LB, R4->RB, L5->L3, R5->R3)
	if (b & TB_L4)
		btn |= codeToXB(g_back[0]);
	if (b & TB_R4)
		btn |= codeToXB(g_back[1]);
	if (b & TB_L5)
		btn |= codeToXB(g_back[2]);
	if (b & TB_R5)
		btn |= codeToXB(g_back[3]);
	uint8_t lt = trigU8(u16off(r, 4)),
		rt = trigU8(u16off(
			r, 6)); // triggers u16 (half-scale) -> full-range u8
	// Trigger remaps (codes 19=LT, 20=RT): XInput triggers are analog bytes, not buttons, so a back paddle /
	// QAM mapped to a trigger pulls it full. QAM arrives as TB_L2/TB_R2 (folded into b via tritonFromCode);
	// back paddles are matched by their configured code.
	if (b & TB_L2)
		lt = 0xFF;
	if (b & TB_R2)
		rt = 0xFF;
	const uint8_t bc[4] = { g_back[0], g_back[1], g_back[2], g_back[3] };
	const uint32_t bm[4] = { TB_L4, TB_R4, TB_L5, TB_R5 };
	for (int i = 0; i < 4; i++) {
		if (!(b & bm[i]))
			continue;
		if (bc[i] == 19)
			lt = 0xFF;
		else if (bc[i] == 20)
			rt = 0xFF;
	}
	xinputSend(slot, btn, lt, rt, (int16_t)s16off(r, 8),
		   (int16_t)s16off(r, 10), // L stick X/Y
		   (int16_t)s16off(r, 12),
		   (int16_t)s16off(r, 14)); // R stick X/Y
}
// Right pad -> mouse on a second HID-mouse interface alongside the XInput gamepad. Same glide model as Lizard's
// right pad; RPad click = left button, LPad click = right. SINGLE shared mouse: the desktop can only consume
// one mouse. Slot 0's right-pad drives it; other slots' right-pad input is intentionally ignored here.
static void rfXboxMouse(const uint8_t *r)
{
	uint32_t b = btnsOf(r);
	static int prx = 0, pry = 0;
	static bool prt = false;
	static float vx = 0, vy = 0, rmx = 0, rmy = 0;
	static uint8_t pmb = 0;
	bool rtouch = b & TB_RPADT;
	int rx = s16off(r, 22), ry = s16off(r, 24);
	if (rtouch) {
		if (prt) {
			vx += (rx - prx);
			vy += (ry - pry);
		}
		prx = rx;
		pry = ry;
	}
	prt = rtouch;
	float mxf = vx / (float)(g_mDiv * 10) + rmx,
	      myf = -(vy / (float)(g_mDiv * 10)) +
		    rmy; // Y inverted for screen coords
	int dx = (int)mxf, dy = (int)myf;
	rmx = mxf - dx;
	rmy = myf - dy; // sub-pixel carry
	if (dx > 127)
		dx = 127;
	if (dx < -127)
		dx = -127;
	if (dy > 127)
		dy = 127;
	if (dy < -127)
		dy = -127;
	float f = g_mFric / 100.0f;
	vx *= f;
	vy *= f;
	if (vx > -1 && vx < 1)
		vx = 0;
	if (vy > -1 && vy < 1)
		vy = 0; // friction = glide/decay
	uint8_t mb = ((b & TB_RPADC) ? 1 : 0) |
		     ((b & TB_LPADC) ?
			      2 :
			      0); // RPad click = left, LPad click = right
	if (dx || dy || mb != pmb) {
		pmb = mb;
		hid_mouse_report_t m;
		m.buttons = mb;
		m.x = (int8_t)dx;
		m.y = (int8_t)dy;
		m.wheel = 0;
		m.pan = 0;
		if (g_mouse.ready())
			g_mouse.sendReport(0, &m, sizeof m);
	}
}

// ===================== IController =====================
// Dynamic-mount mode: begin() is unused (setup() calls beginPool()+usbReenumerate instead).
void XboxController::begin()
{
}
// XInput slot interfaces are a custom (non-HID) class, so they don't draw on the CFG_TUD_HID budget (only the
// wake mouse + right-pad mouse do). Slots are limited by NSLOT / USB endpoints, not HID instances.
uint8_t XboxController::maxSlots() const
{
	return (uint8_t)NSLOT;
}
void XboxController::usbIdentity()
{
	// 045E:028E -> Windows xusb / SDL / Linux xpad all bind it
	USBDevice.setID(0x045E, 0x028E);
	USBDevice.setDeviceVersion(0x0120);
	USBDevice.setManufacturerDescriptor("Microsoft");
	USBDevice.setProductDescriptor("Controller");
}
void XboxController::beginPool()
{
	// Lock the right-pad mouse HID instance (wake mouse was begun first by setup -> this is HID instance 1).
	g_mouse.setStringDescriptor("OpenPuck Mouse");
	g_mouse.setBootProtocol(HID_ITF_PROTOCOL_MOUSE);
	g_mouse.setReportDescriptor(MOUSE_HID_DESC, sizeof MOUSE_HID_DESC);
	g_mouse.setPollInterval(1);
	g_mouse.begin();
	for (int s = 0; s < NSLOT; s++)
		g_xinput[s].setStringDescriptor("Controller");
	// Zephyr: request the XInput vendor class be registered this boot.
	opk_xinput_begin();
}
void XboxController::mountSlots(uint8_t k)
{
	// Right-pad mouse first (fixed HID), then one XInput interface per connected controller (claimed in
	// order by xi_open). The wake mouse + WebUSB are added around this by usbReenumerate.
	USBDevice.addInterface(g_mouse);
	for (uint8_t u = 0; u < k; u++)
		USBDevice.addInterface(g_xinput[u]);
}
void XboxController::onReport45(int slot, const uint8_t *rep, bool fresh,
				uint8_t bodyTlen)
{
	(void)fresh;
	(void)bodyTlen;
	if (slot < 0 || slot >= NSLOT)
		return;
	rfXboxGamepad((uint8_t)slot, rep);
	// Shared desktop mouse: slot 0's right-pad only. Other slots' right-pad is still part of the
	// per-slot XInput (TB_RPADT in the gamepad report is unused today but kept for forward-compat).
	if (slot == 0)
		rfXboxMouse(rep);
}
// Lost-stop watchdog per slot: Steam/Triton rumble is latched, so force a zero report if the host stops
// refreshing on a particular XInput. The haptics.cpp global watchdog fires too, but it skips while the slot
// is in the post-reconnect block -- this catches a host that kept streaming while we were blocked.
void XboxController::task()
{
	for (int s = 0; s < NSLOT; s++) {
		if (!g_xiSlot[s].inUse)
			continue;
		if ((g_xiSlot[s].rumbleLow || g_xiSlot[s].rumbleHigh) &&
		    millis() - g_xiSlot[s].rumbleMs > RUMBLE_STUCK_MS) {
			g_xiSlot[s].rumbleLow = g_xiSlot[s].rumbleHigh = 0;
			hapticSteamRumble(0, 0, (uint8_t)s);
		}
	}
}
```
